## drivers/net/wireless/mt7601u/Kconfig
```kconfig
config MT7601U
	tristate "MediaTek MT7601 USB WiFi"
	depends on MAC80211 && USB && EXPERIMENTAL
	---help---
	  Help message of MT7601U
```

## drivers/net/wireless/rtl8188e/Kconfig
```kconfig
config RTL8188EU
	tristate "Realtek 8188E USB WiFi"
	depends on MAC80211 && USB && EXPERIMENTAL
	---help---
	  Help message of RTL8188EU
```
